## drivers/block/sb/Kconfig
```kconfig
# SPDX-License-Identifier: GPL-2.0
config BLK_SB
	tristate "simple block device"
	help
	  very simple block device
```

## drivers/clk/spinalhdl/Kconfig
```kconfig
# SPDX-License-Identifier: GPL-2.0

menuconfig CLK_SPINAL
	bool "SpinalHDL clock driver support"
	help
	  Clock drivers for SpinalHDL Linux-capable SoCs.

if CLK_SPINAL

config CLK_SPINAL_MMCME2
	bool "MMCME2 driver for Spinal's SoC"
	help
	  Enable support of Xilinx MMCME2 pll reconfiguration

endif
```

## drivers/net/ethernet/spinalhdl/Kconfig
```kconfig
config NET_VENDOR_SPINAL
	bool "SpinalHDL devices"
	default n
	help
	  If you have a network (Ethernet) card belonging to this class, say Y.

	  Note that the answer to this question doesn't directly affect the
	  kernel: saying N will just cause the configurator to skip all
	  the questions about LiteX devices. If you say Y, you will be asked
	  for your specific card in the following questions.

if NET_VENDOR_SPINAL

config SPINAL_LIB_MAC
	tristate "SpinalHDL Ethernet MAC support"
	select NET_CORE
	select MII
	select PHYLIB
	help
	  If you wish to compile a kernel for hardware with a SpinalHDL Ethernet mac
	  device then you should answer Y to this.

endif # NET_VENDOR_SPINAL
```

## sound/spinal/Kconfig
```kconfig
config SND_SPINAL_LIB_AUDIO_OUT
	tristate "Audio support for the Spinal lib audio out"
	select SND_PCM
	help
	  Select this option to enable Spinal lib audio out
```
